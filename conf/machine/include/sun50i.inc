## conf/machine/include/sun50i.inc
```bitbake
require conf/machine/include/sunxi.inc
require conf/machine/include/sunxi-mali.inc
require conf/machine/include/arm/arch-armv8.inc

KERNEL_IMAGETYPE = "Image"

SOC_FAMILY = "sun50i"
```

## conf/machine/orange-pi-pc2.conf
```bitbake
#@TYPE: Machine
#@NAME: orange-pi-pc2
#@DESCRIPTION: Machine configuration for the orange-pi-pc2, based on allwinner H5 CPU

require conf/machine/include/sun50i.inc

#PREFERRED_VERSION_linux = ""
PREFERRED_VERSION_u-boot = "v2017.09 %"

KERNEL_DEVICETREE = "allwinner/sun50i-h5-orangepi-pc2.dtb"
UBOOT_MACHINE = "orangepi_pc2_defconfig"

#DEFAULTTUNE = "cortexa53"
#DEFAULTTUNE = "cortexa7hf-neon-vfpv4"
```

## conf/machine/pcduino3-nano.conf
```bitbake
#@TYPE: Machine
#@NAME: pcDuino3 Nano
#@DESCRIPTION: Machine configuration for the pcDuino3 Nano, based on allwinner A20 CPU http://www.linksprite.com/linksprite-pcduino3-nano/

require conf/machine/include/sun7i.inc

KERNEL_DEVICETREE = "sun7i-a20-pcduino3-nano.dtb"
UBOOT_MACHINE = "Linksprite_pcDuino3_Nano_defconfig"
IMAGE_INSTALL_append = " kernel-devicetree"

DEFAULTTUNE = "cortexa7hf-neon-vfpv4"
```

## conf/machine/pine64-plus.conf
```bitbake
#@TYPE: Machine
#@NAME: pine64
#@DESCRIPTION: Machine configuration for the Pine 64 Plus,based on allwinner A64 SOC

require conf/machine/include/sun50i.inc

#PREFERRED_VERSION_linux = ""
PREFERRED_VERSION_u-boot = "v2017.09 %"

KERNEL_DEVICETREE = "allwinner/sun50i-a64-pine64-plus.dtb"
UBOOT_MACHINE = "pine64_plus_defconfig"

#DEFAULTTUNE = "cortexa53"
#DEFAULTTUNE = "cortexa7hf-neon-vfpv4"
```
